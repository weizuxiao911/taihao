## packaging/buildroot-pi4b/Config.in
```kconfig
config BR2_PACKAGE_TAIHAO
	bool "太昊 OS 服务层"
	help
	  太昊 OS 服务层 5 模块:pi-agent / rt-loop / hal-gateway /
	  comm-center / extension-bridge。

source "$BR2_EXTERNAL_TAIHAO_PI4B_PATH/package/pi-agent/Config.in"
source "$BR2_EXTERNAL_TAIHAO_PI4B_PATH/package/rt-loop/Config.in"
source "$BR2_EXTERNAL_TAIHAO_PI4B_PATH/package/hal-gateway/Config.in"
source "$BR2_EXTERNAL_TAIHAO_PI4B_PATH/package/comm-center/Config.in"
source "$BR2_EXTERNAL_TAIHAO_PI4B_PATH/package/extension-bridge/Config.in"
```

## packaging/buildroot-pi4b/configs/taihao_pi4b_defconfig
```kconfig
# 太昊 OS · 树莓派 Pi 4B 板型(基座 OS 真机批次)
# 依据:docs/linux-内核裁剪方案.md §8(真机配置分离)+ AGENTS.md 技术选型
# 基板:官方 raspberrypi4_64_defconfig(Buildroot 2024.05)+ 太昊 5 服务包

# ===== 架构 =====
BR2_aarch64=y
BR2_cortex_a72=y

# ===== 内核(树莓派官方内核 bcm2711)=====
BR2_LINUX_KERNEL=y
BR2_LINUX_KERNEL_CUSTOM_TARBALL=y
BR2_LINUX_KERNEL_CUSTOM_TARBALL_LOCATION="$(call github,raspberrypi,linux,17f135b742c4edb340afb365873c3a574f7e16cb)/linux-17f135b742c4edb340afb365873c3a574f7e16cb.tar.gz"
BR2_LINUX_KERNEL_DEFCONFIG="bcm2711"
BR2_LINUX_KERNEL_DTS_SUPPORT=y
BR2_LINUX_KERNEL_INTREE_DTS_NAME="broadcom/bcm2711-rpi-4-b"
BR2_LINUX_KERNEL_NEEDS_HOST_OPENSSL=y
BR2_PACKAGE_HOST_LINUX_HEADERS_CUSTOM_6_1=y

# ===== 树莓派固件 =====
BR2_PACKAGE_RPI_FIRMWARE=y
BR2_PACKAGE_RPI_FIRMWARE_VARIANT_PI4=y
BR2_PACKAGE_RPI_FIRMWARE_CONFIG_FILE="$(BR2_EXTERNAL_TAIHAO_PI4B_PATH)/board/raspberrypi4-64/config_4_64bit.txt"

# ===== 工具链 =====
BR2_TOOLCHAIN_BUILDROOT_GLIBC=y
BR2_TOOLCHAIN_BUILDROOT_CXX=y

# ===== init / 基础 =====
BR2_INIT_SYSTEMD=y
BR2_PACKAGE_SYSTEMD=y
BR2_PACKAGE_BUSYBOX=y
BR2_PACKAGE_UTIL_LINUX=y
BR2_PACKAGE_IPROUTE2=y
BR2_PACKAGE_OPENSSL=y

# ===== 太昊 OS 服务层 =====
BR2_PACKAGE_TAIHAO=y
BR2_PACKAGE_PI_AGENT=y
BR2_PACKAGE_RT_LOOP=y
BR2_PACKAGE_HAL_GATEWAY=y
BR2_PACKAGE_COMM_CENTER=y
BR2_PACKAGE_EXTENSION_BRIDGE=y

# ===== rootfs overlay + 脚本 =====
BR2_ROOTFS_OVERLAY="$(BR2_EXTERNAL_TAIHAO_PI4B_PATH)/overlays/rootfs"
BR2_ROOTFS_POST_BUILD_SCRIPT="$(BR2_EXTERNAL_TAIHAO_PI4B_PATH)/scripts/post-build.sh"
BR2_ROOTFS_POST_IMAGE_SCRIPT="$(BR2_EXTERNAL_TAIHAO_PI4B_PATH)/scripts/post-image.sh"

# ===== 文件系统镜像 =====
BR2_TARGET_ROOTFS_EXT2=y
BR2_TARGET_ROOTFS_EXT2_4=y
BR2_TARGET_ROOTFS_EXT2_SIZE="1G"

# ===== SD 卡镜像工具 =====
BR2_PACKAGE_HOST_DOSFSTOOLS=y
BR2_PACKAGE_HOST_GENIMAGE=y
BR2_PACKAGE_HOST_MTOOLS=y

# ===== Rust 工具链(服务层交叉编译)=====
BR2_PACKAGE_HOST_RUSTC=y
BR2_PACKAGE_HOST_CARGO=y
BR2_PACKAGE_HOST_RUSTC_ARCH_EXTENSION="+crc"

# ===== 杂项 =====
BR2_CCACHE=y
BR2_PACKAGE_CA_CERTIFICATES=y
```

## packaging/buildroot-pi4b/package/comm-center/Config.in
```kconfig
config BR2_PACKAGE_COMM_CENTER
	bool "comm-center"
	depends on BR2_PACKAGE_TAIHAO
	help
	  太昊 OS 服务层模块。
```

## packaging/buildroot-pi4b/package/extension-bridge/Config.in
```kconfig
config BR2_PACKAGE_EXTENSION_BRIDGE
	bool "extension-bridge"
	depends on BR2_PACKAGE_TAIHAO
	help
	  太昊 OS 服务层模块。
```

## packaging/buildroot-pi4b/package/hal-gateway/Config.in
```kconfig
config BR2_PACKAGE_HAL_GATEWAY
	bool "hal-gateway"
	depends on BR2_PACKAGE_TAIHAO
	help
	  太昊 OS 服务层模块。
```

## packaging/buildroot/configs/taihao_defconfig
```kconfig
# 太昊 OS · qemu-aarch64 基座板型
# 依据:docs/linux-内核裁剪方案.md §1 / §2.1;AGENTS.md 技术选型

# ===== 架构 =====
BR2_aarch64=y
BR2_cortex_a72=y

# ===== 内核:复用契约裁剪方案产物(不由 Buildroot 构建) =====
# 内核 Image 由 scripts/kernel-build/build-kernel.sh 产出
# Buildroot 仅打包 rootfs;内核以外部 Image 提供(qemu 启动参数 -kernel)

# ===== 系统 =====
BR2_ROOTFS_OVERLAY="$(BR2_EXTERNAL_TAIHAO_PATH)/overlays/rootfs"
BR2_ROOTFS_POST_BUILD_SCRIPT="$(BR2_EXTERNAL_TAIHAO_PATH)/scripts/post-build.sh"
BR2_ROOTFS_POST_IMAGE_SCRIPT="$(BR2_EXTERNAL_TAIHAO_PATH)/scripts/post-image.sh"

# ===== 工具链 =====
BR2_TOOLCHAIN_BUILDROOT_GLIBC=y
BR2_TOOLCHAIN_BUILDROOT_CXX=y

# ===== init / 基础 =====
BR2_INIT_SYSTEMD=y
BR2_PACKAGE_SYSTEMD=y
BR2_PACKAGE_BUSYBOX=y
BR2_PACKAGE_UTIL_LINUX=y

# ===== 网络 / 协议 =====
BR2_PACKAGE_IPROUTE2=y
BR2_PACKAGE_OPENSSL=y

# ===== 太昊 OS 服务层 =====
BR2_PACKAGE_TAIHAO=y
BR2_PACKAGE_PI_AGENT=y
BR2_PACKAGE_RT_LOOP=y
BR2_PACKAGE_HAL_GATEWAY=y
BR2_PACKAGE_COMM_CENTER=y
BR2_PACKAGE_EXTENSION_BRIDGE=y

# ===== 文件系统镜像 =====
BR2_TARGET_ROOTFS_EXT2=y
BR2_TARGET_ROOTFS_EXT2_4=y
BR2_TARGET_ROOTFS_EXT2_SIZE="1G"

# ===== 目标文件系统打包 =====
BR2_PACKAGE_HOST_GENEXT2FS=y
BR2_PACKAGE_HOST_E2FSPROGS=y

# ===== Rust 工具链(服务层交叉编译) =====
BR2_PACKAGE_HOST_RUSTC=y
BR2_PACKAGE_HOST_CARGO=y
BR2_PACKAGE_HOST_RUSTC_ARCH_EXTENSION="+crc"

# ===== 杂项 =====
BR2_GLOBAL_PATCH_DIR="$(BR2_EXTERNAL_TAIHAO_PATH)/patches"
BR2_CCACHE=y
BR2_PACKAGE_CA_CERTIFICATES=y
```

## packaging/buildroot/package/pi-agent/Config.in
```kconfig
config BR2_PACKAGE_PI_AGENT
	bool "pi-agent"
	depends on BR2_PACKAGE_TAIHAO
	help
	  太昊 OS 认知决策层载体:Agent Loop / SKILL Registry /
	  Provider 抽象 / Hooks / Extension。
```

## packaging/buildroot/package/rt-loop/Config.in
```kconfig
config BR2_PACKAGE_RT_LOOP
	bool "rt-loop"
	depends on BR2_PACKAGE_TAIHAO
	help
	  太昊 OS 服务层模块。
```

## packaging/buildroot/package/taihao-comm-center/Config.in
```kconfig
config BR2_PACKAGE_TAIHAO_COMM_CENTER
	bool "taihao-comm-center"
	depends on BR2_PACKAGE_HOST_RUSTC_TARGET_ARCH_SUPPORTS
	select BR2_PACKAGE_HOST_RUSTC
	help
	  太昊 OS 中台调度通信模块 — 双链路选择 + 消息路由 + 故障切换。

	  远程链路（SSE/WS/MQTT，4G/5G 通道）+ 本地 Mesh（UDP 自组网）；
	  配置 /etc/taihao-os/comm-center.toml；
	  状态 /var/lib/taihao-os/comm-center/status.json。
	  对接对象由厂商配置决定。
```

## packaging/buildroot/package/taihao-extension-bridge/Config.in
```kconfig
config BR2_PACKAGE_TAIHAO_EXTENSION_BRIDGE
	bool "taihao-extension-bridge"
	depends on BR2_PACKAGE_HOST_RUSTC_TARGET_ARCH_SUPPORTS
	select BR2_PACKAGE_HOST_RUSTC
	help
	  太昊 OS Extension·MCP 桥 — JSON-RPC 桥接 + 工具白名单 + 权限边界。

	  请求目录 /var/lib/taihao-os/extension-bridge/requests；
	  配置 /etc/taihao-os/extension-bridge.toml。
	  运行于受限沙箱（无 capabilities，无网络）。
```

## packaging/buildroot/package/taihao-hal-gateway/Config.in
```kconfig
config BR2_PACKAGE_TAIHAO_HAL_GATEWAY
	bool "taihao-hal-gateway"
	depends on BR2_PACKAGE_HOST_RUSTC_TARGET_ARCH_SUPPORTS
	select BR2_PACKAGE_HOST_RUSTC
	help
	  太昊 OS HAL 网关 — 硬件调用的唯一入口（白名单校验 + 审计日志）。

	  请求目录 /var/lib/taihao-os/hal-gateway/requests；
	  审计日志 /var/log/taihao-os/hal-audit.log；
	  配置 /etc/taihao-os/hal-gateway.toml。
	  持有 CAP_SYS_RAWIO / CAP_NET_ADMIN（四层隔离栈中唯一硬件访问权）。
```

## packaging/buildroot/package/taihao-pi-agent/Config.in
```kconfig
config BR2_PACKAGE_TAIHAO_PI_AGENT
	bool "taihao-pi-agent"
	depends on BR2_PACKAGE_HOST_RUSTC_TARGET_ARCH_SUPPORTS
	select BR2_PACKAGE_HOST_RUSTC
	help
	  太昊 OS Pi Agent — 唯一智能决策层（Agent Loop / SKILL Registry / Provider）。

	  决策输出 /var/lib/taihao-os/pi-agent/decision.json；
	  配置 /etc/taihao-os/pi-agent.toml。
```

## packaging/buildroot/package/taihao-rt-loop/Config.in
```kconfig
config BR2_PACKAGE_TAIHAO_RT_LOOP
	bool "taihao-rt-loop"
	depends on BR2_PACKAGE_HOST_RUSTC_TARGET_ARCH_SUPPORTS
	select BR2_PACKAGE_HOST_RUSTC
	help
	  太昊 OS 高频实时回路 — 10~100Hz 运动控制骨架。

	  消费 /var/lib/taihao-os/pi-agent/decision.json（≤1Hz 目标/模式）；
	  输出 /var/lib/taihao-os/rt-loop/actuator.json；
	  配置 /etc/taihao-os/rt-loop.toml。
	  运行于受限沙箱（无 capabilities）。
```
